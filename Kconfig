## Kconfig
```kconfig
mainmenu "Xelix configuration"

config ARCH
	string "Target architecture"
	default "i386"
	---help---
	Build target architecture. Can be either "i386" or "arm".

menu "Interrupts"
	config INTERRUPTS_DEBUG
		bool "Interrupts debugging"

	config PIT_RATE
		int "PIT tick rate / scheduling frequency (In Hz)"
		default 1000
		---help---
		How often the interrupt timer should fire per second. This is also
		the task switching frequency, and the maximum time resolution.
endmenu

menu "Kernel stdlib"
	config LOG_STORE
		bool "Store kernel logs"
		default y
		---help---
		Store kernel log in memory and make them available as /sys/log, where
		it can be read by utilities like dmesg. Doesn't log debug messages.

	config LOG_PRINT_LEVEL
		int "TTY log level"
		default 2
		---help---
		0 Disabled
		1 Debug
		2 Info
		3 Warn
		4 Error

	config LOG_SERIAL_LEVEL
		int "Serial log level"
		default 0
		---help---
		0 Disabled
		1 Debug
		2 Info
		3 Warn
		4 Error
endmenu

menu "Memory"
	config VM_DEBUG
		bool "vm: Enable virtual memory allocation debugging support"
		---help---
		Print out information for each allocation/free to serial. Makes
		everything pretty slow.

	config VM_DEBUG_ALL
		bool "vm: Debug all allocations"
                depends on VM_DEBUG
		---help---
		Print out information for each allocation/free to serial. Makes
		everything pretty slow.

	config KMALLOC_DEBUG
		bool "kmalloc: Enable debugging"
		---help---
		Print out information for each allocation/free to serial. Makes
		everything pretty slow.

	config KMALLOC_CHECK
		bool "kmalloc: Check all headers against buffer overflows/OOB"
		---help---
		Simple bounds/buffer overflow checking by inserting canaries at the
		beginning and end of all internal structures (which are placed before and
		after the actual allocations and tend to get overwritten on buffer overflow).
		Wastes memory and makes things slow. Only use during development.
endmenu

menu "Tasks"
	config ELF_DEBUG
		bool "ELF loader debugging"

	config SYSCALL_DEBUG
		bool "Syscall debugging"

	config INIT_PATH
		string "Init process path"
		default "/usr/bin/init"

	config EXECDATA_LOCATION
		hex "Execdata virtual memory location"
		default 0x5000

	config MMAP_BASE
		hex "Lower base address for mmap allocations"
		default 0xa000000
endmenu

menu "Audio"
	config ENABLE_AC97
	bool "AC97 sound chip driver"
	default y
endmenu

menu "Networking"
	config ENABLE_PICOTCP
	bool "Enable PicoTCP integration"
	default y

	config SOCKET_DEBUG
	bool "Socket translation layer debugging"
	default n

	config ENABLE_VIRTIO_NET
	bool "VirtIO network driver"
	default y
	depends on ENABLE_PICOTCP

	config ENABLE_NE2K
	bool "NE2000 NIC driver"
	default y
	depends on ENABLE_PICOTCP

	config ENABLE_RTL8139
	bool "RTL8139 NIC driver"
	default n
	depends on ENABLE_PICOTCP

	config RTL8139_MAX_CARDS
	int "Maximum number of cards supported by RTL8139 driver"
	default 4
	depends on ENABLE_RTL8139
endmenu


menu "File systems"
	config VFS_MAX_MOUNTPOINTS
	int "Maximum active mount points"
	default 50

	config VFS_MAX_OPENFILES
	int "Maximum open files"
	default 500

	config ENABLE_VIRTIO_BLOCK
	bool "Enable VirtIO block device driver"
	default y

	config ENABLE_EXT2
	bool "Enable ext2 support"
	default y

	config EXT2_DEBUG
	bool "ext2 file system debugging"
	depends on ENABLE_EXT2
endmenu
```
